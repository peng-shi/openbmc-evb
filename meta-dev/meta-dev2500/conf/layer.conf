## meta-dev/meta-dev2500/conf/layer.conf
```bitbake
# We have a conf and classes directory, add to BBPATH
BBPATH .= ":${LAYERDIR}"

# We have recipes-* directories, add to BBFILES
BBFILES += "${LAYERDIR}/recipes-*/*/*.bb \
	${LAYERDIR}/recipes-*/*/*.bbappend"

BBFILE_COLLECTIONS += "dev2500-layer"
BBFILE_PATTERN_dev2500-layer = "^${LAYERDIR}/"
BBFILE_PRIORITY_dev2500-layer = "6"

LAYERSERIES_COMPAT_dev2500-layer = "langdale mickledore"
```

## meta-dev/meta-dev2500/conf/machine/dev2500.conf
```bitbake
KMACHINE = "aspeed"
KERNEL_DEVICETREE = "${KMACHINE}-bmc-${MACHINE}.dtb"

UBOOT_DEVICETREE = "ast2500-evb"
UBOOT_MACHINE = "evb-ast2500_defconfig"

require conf/machine/include/ast2500.inc
require conf/machine/include/obmc-bsp-common.inc
require conf/machine/include/dev.inc

SERIAL_CONSOLES = "115200;ttyS4"

FLASH_SIZE = "32768"

PREFERRED_PROVIDER_virtual/phosphor-led-manager-config-native = "dev2500-led-manager-config-native"
```
